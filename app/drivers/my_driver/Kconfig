## boards/bluepill_c6/Kconfig.bluepill_c6
```kconfig
# STM32 BLUE PILL CLONE STM32F103C6T6

config BOARD_BLUEPILL_C6
	select SOC_STM32F103X8
```

## boards/bluepill_c6/Kconfig.defconfig
```kconfig
# STM32 BLUEPILL CLONE STM32F103C6T6

if BOARD_BLUEPILL_C6

config BOARD
	default "bluepill_c6"

endif # BOARD_BLUEPILL_C6
```

## boards/bluepill_c6/bluepill_c6_defconfig
```kconfig
# STM32 BLUE PILL CLONE STM32F103C6T6


# enable uart driver
CONFIG_SERIAL=y

# enable console
CONFIG_CONSOLE=y
CONFIG_UART_CONSOLE=y

# enable GPIO
CONFIG_GPIO=y
```

## boards/bluepill_c6/board.yml
```yaml
board:
  name: bluepill_c6
  full_name: STM32 BLUEPILL CLONE STM32F103C6T6
  vendor: others
  socs:
    - name: stm32f103xb
```

## boards/stm32_bluepill/Kconfig.defconfig
```kconfig
# SPDX-License-Identifier: Apache-2.0

if BOARD_STM32_BLUEPILL

config BOARD
	default "bluepill"

endif # BOARD_STM32_BLUEPILL
```

## boards/stm32_bluepill/board.yml
```yaml
board:
  name: stm32_bluepill
  full_name: STM32 Minimum Development Board Custom (Blue Pill)
  vendor: others
  revision:
    format: custom
    default: "blue"
    revisions:
      - name: "blue"
      - name: "black"
  socs:
    - name: stm32f103xb
```

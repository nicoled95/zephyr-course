## CMakeLists.txt
```
cmake_minimum_required(VERSION 3.20.0)

list(APPEND BOARD_ROOT "${CMAKE_CURRENT_SOURCE_DIR}/..")
list(APPEND DTS_ROOT "${CMAKE_CURRENT_SOURCE_DIR}/..")

find_package(Zephyr REQUIRED)
project(my_zephyr_app)

target_sources(app PRIVATE src/main.cpp)
add_subdirectory(drivers/my_driver)
```

## Kconfig
```
source "Kconfig.zephyr"
rsource "drivers/my_driver/Kconfig"
```

## prj.conf
```kconfig
CONFIG_GPIO=y
CONFIG_LOG=y
CONFIG_PRINTK=y
CONFIG_SENSOR=y
CONFIG_MY_DRIVER=y
```

## app.overlay
```dts
/ {
	my_driver0: my_driver0 {
		compatible = "my,driver";
		status = "okay";
	};

};
```

## boards/stm32_bluepill.overlay
```dts
/*
 * Copyright (c) 2017, embedjournal.com
 *
 * SPDX-License-Identifier: Apache-2.0
 */

/ {
	model = "STM32 Minimum Development Board (Blue Pill)";
	compatible = "stm32_min_dev_blue", "st,stm32f103c8";

	leds {
		led: led {
			gpios = <&gpioc 13 GPIO_ACTIVE_LOW>;
		};
	};
};

&sram0 {
	reg = <0x20000000 DT_SIZE_K(10)>;
};
```

## boards/stm32_min_dev_stm32f103xb_blue.overlay
```dts
&sram0 {
    reg = <0x20000000 DT_SIZE_K(10)>;
};
```

## src/main.cpp
```c
#include <zephyr/kernel.h>
#include <zephyr/device.h>
#include <zephyr/drivers/sensor.h>
#include <zephyr/logging/log.h>

#include "my_driver.h"

LOG_MODULE_REGISTER(main, LOG_LEVEL_INF);

#define SLEEP_TIME_MS 1000

static const struct device *const my_led = DEVICE_DT_GET(DT_NODELABEL(my_driver0));

int main(void)
{
	struct sensor_value val;
	int cycle = 0;
	int ret;

	if (!device_is_ready(my_led)) {
		LOG_ERR("my_driver not ready");
		return 0;
	}

	while (1) {
		if (cycle++ == 3) {
			ret = my_driver_set_inverted(my_led, true);
			LOG_INF("set_inverted ret=%d", ret);
		}

		ret = sensor_sample_fetch(my_led);
		LOG_INF("sample_fetch ret=%d", ret);
		k_msleep(SLEEP_TIME_MS);

		ret = sensor_channel_get(my_led, SENSOR_CHAN_ALL, &val);
		LOG_INF("channel_get ret=%d", ret);
		k_msleep(SLEEP_TIME_MS);
	}
	return 0;
}
```
